## patch_for_kernel_4.10.0/demo_for_with_src_compile/Kconfig
```kconfig
#
# Linux Demo (self-implement)
#
menu "DEMO Driver "
comment " DEMO Driver"

config HELLO_WORLD
    tristate "HELLO WORLD"
endmenu
```
